## CMakeLists.txt
```
cmake_minimum_required(VERSION 3.27)

set(CMAKE_CXX_STANDARD 23)
set(CMAKE_CXX_STANDARD_REQUIRED ON)
set(CMAKE_CXX_EXTENSIONS OFF)

find_package(Zephyr REQUIRED HINTS $ENV{ZEPHYR_BASE})
project(VibrationMonitor ASM C CXX)

list(APPEND CMAKE_MODULE_PATH ${CMAKE_SOURCE_DIR}/cmake)
include(CPM)

add_subdirectory(third_party)
add_subdirectory(src)
```

## prj.conf
```kconfig
CONFIG_I2C=y
CONFIG_SPI=y
CONFIG_SPI_NRFX_RAM_BUFFER_SIZE=64
CONFIG_GPIO=y
CONFIG_SENSOR=y
CONFIG_KERNEL_BIN_NAME="out/VibrationMonitor"
CONFIG_USB_DEVICE_DRIVER=n
CONFIG_USB_DEVICE_STACK=n
CONFIG_SYSTEM_WORKQUEUE_STACK_SIZE=2048
CONFIG_MAIN_STACK_SIZE=4096
CONFIG_CPP=y

# Enable serial communication for UART
CONFIG_SERIAL=y
CONFIG_UART_CONSOLE=y
CONFIG_PRINTK=y
CONFIG_LOG_BACKEND_UART=n
CONFIG_CONSOLE=y
CONFIG_LOG_BACKEND_RTT_OUTPUT_DICTIONARY=y

# File System
CONFIG_DISK_ACCESS=y
CONFIG_FILE_SYSTEM=y
CONFIG_FAT_FILESYSTEM_ELM=y
CONFIG_FS_FATFS_EXFAT=y
CONFIG_DISK_DRIVER_SDMMC=y

# CONFIG_BT=n
# CONFIG_BT_SMP=n
# CONFIG_BT_SIGNING=n
# CONFIG_BT_PERIPHERAL=n
# CONFIG_BT_DIS=n
# CONFIG_BT_ATT_PREPARE_COUNT=5
# CONFIG_BT_BAS=n
# CONFIG_BT_HRS=n
# CONFIG_BT_IAS=n
# CONFIG_BT_PRIVACY=n
# CONFIG_BT_DEVICE_NAME="Vibration Monitor"
# CONFIG_BT_DEVICE_APPEARANCE=833
# CONFIG_BT_DEVICE_NAME_DYNAMIC=n
# CONFIG_BT_DEVICE_NAME_MAX=65
# CONFIG_BT_KEYS_OVERWRITE_OLDEST=n
# CONFIG_BT_SETTINGS=n
```

## src/main.cpp
```c
#include <stdio.h>
#include <zephyr/kernel.h>

#include "accelerometer.h"
#include "sd.h"

int main()
{
    init_sd_card();
    init_accelerometer();

    accelerometer_data data;
    while (1)
    {
        k_sleep(K_MSEC(1000));
        get_accelerometer_data(data);
        print_accelerometer_data(data);
    }
    return 0;
}
```

## src/accelerometer.cpp
```c
#include "accelerometer.h"

#include <zephyr/device.h>
#include <zephyr/drivers/sensor.h>

const struct device* dev_sensor;

static inline float out_ev(struct sensor_value* val)
{
    return (val->val1 + (float)val->val2 / 1000000);
}

static int set_sampling_freq(const struct device* dev)
{
    int ret = 0;
    struct sensor_value odr_attr;

    /* set accel/gyro sampling frequency to 12.5 Hz */
    odr_attr.val1 = 12;
    odr_attr.val2 = 500000;

    ret = sensor_attr_set(dev, SENSOR_CHAN_ACCEL_XYZ, SENSOR_ATTR_SAMPLING_FREQUENCY, &odr_attr);
    if (ret != 0)
    {
        printk("Cannot set sampling frequency for accelerometer.\n");
        return ret;
    }

    ret = sensor_attr_set(dev, SENSOR_CHAN_GYRO_XYZ, SENSOR_ATTR_SAMPLING_FREQUENCY, &odr_attr);
    if (ret != 0)
    {
        printk("Cannot set sampling frequency for gyro.\n");
        return ret;
    }

    return 0;
}

void init_accelerometer()
{
    dev_sensor = DEVICE_DT_GET(DT_NODELABEL(lsm6ds3tr_c));

    if (!device_is_ready(dev_sensor))
    {
        printk("Device lsm6ds3 is not ready\n");
        return;
    }

    if (set_sampling_freq(dev_sensor) != 0)
    {
        printk("Device lsm6ds3 failed to set sampling frequency\n");
        return;
    }
}

void get_accelerometer_data(accelerometer_data& data)
{
    struct sensor_value x, y, z;

    /* lsm6dso accel */
    sensor_sample_fetch_chan(dev_sensor, SENSOR_CHAN_ACCEL_XYZ);
    sensor_channel_get(dev_sensor, SENSOR_CHAN_ACCEL_X, &x);
    sensor_channel_get(dev_sensor, SENSOR_CHAN_ACCEL_Y, &y);
    sensor_channel_get(dev_sensor, SENSOR_CHAN_ACCEL_Z, &z);

    data.x_accel = out_ev(&x);
    data.y_accel = out_ev(&y);
    data.z_accel = out_ev(&z);

    /* lsm6dso gyro */
    sensor_sample_fetch_chan(dev_sensor, SENSOR_CHAN_GYRO_XYZ);
    sensor_channel_get(dev_sensor, SENSOR_CHAN_GYRO_X, &x);
    sensor_channel_get(dev_sensor, SENSOR_CHAN_GYRO_Y, &y);
    sensor_channel_get(dev_sensor, SENSOR_CHAN_GYRO_Z, &z);

    data.x_gyro = out_ev(&x);
    data.y_gyro = out_ev(&y);
    data.z_gyro = out_ev(&z);
}

void print_accelerometer_data(const accelerometer_data& data)
{
    printk("accel x:%f ms/2 y:%f ms/2 z:%f ms/2\n", data.x_accel, data.y_accel, data.z_accel);
    printk("gyro x:%f rad/s y:%f rad/s z:%f rad/s\n", data.x_gyro, data.y_gyro, data.z_gyro);
}
```

## src/accelerometer.h
```c
#pragma once

struct accelerometer_data
{
    float x_accel = 0.f;
    float y_accel = 0.f;
    float z_accel = 0.f;
    float x_gyro = 0.f;
    float y_gyro = 0.f;
    float z_gyro = 0.f;
};

void init_accelerometer();

void get_accelerometer_data(accelerometer_data& data);

void print_accelerometer_data(const accelerometer_data& data);
```

## src/bt.c
```c
#include <stddef.h>
#include <zephyr/bluetooth/bluetooth.h>
#include <zephyr/bluetooth/hci.h>
#include <zephyr/sys/printk.h>
#include <zephyr/sys/util.h>
#include <zephyr/types.h>

#define DEVICE_NAME CONFIG_BT_DEVICE_NAME
#define DEVICE_NAME_LEN (sizeof(DEVICE_NAME) - 1)

/*
 * Set Advertisement data. Based on the Eddystone specification:
 * https://github.com/google/eddystone/blob/master/protocol-specification.md
 * https://github.com/google/eddystone/tree/master/eddystone-url
 */
static const struct bt_data ad[] = {
    BT_DATA_BYTES(BT_DATA_FLAGS, BT_LE_AD_NO_BREDR), BT_DATA_BYTES(BT_DATA_UUID16_ALL, 0xaa, 0xfe),
    BT_DATA_BYTES(BT_DATA_SVC_DATA16,
                  0xaa,
                  0xfe, /* Eddystone UUID */
                  0x10, /* Eddystone-URL frame type */
                  0x00, /* Calibrated Tx power at 0m */
                  0x00, /* URL Scheme Prefix http://www. */
                  'z',
                  'e',
                  'p',
                  'h',
                  'y',
                  'r',
                  'p',
                  'r',
                  'o',
                  'j',
                  'e',
                  'c',
                  't',
                  0x08) /* .org */
};

/* Set Scan Response data */
static const struct bt_data sd[] = {
    BT_DATA(BT_DATA_NAME_COMPLETE, DEVICE_NAME, DEVICE_NAME_LEN),
};

void bt_ready(int err)
{
    char addr_s[BT_ADDR_LE_STR_LEN];
    bt_addr_le_t addr = {0};
    size_t count = 1;

    if (err)
    {
        printk("Bluetooth init failed (err %d)\n", err);
        return;
    }

    printk("Bluetooth initialized\n");

    /* Start advertising */
    err = bt_le_adv_start(BT_LE_ADV_NCONN_IDENTITY, ad, ARRAY_SIZE(ad), sd, ARRAY_SIZE(sd));
    if (err)
    {
        printk("Advertising failed to start (err %d)\n", err);
        return;
    }

    /* For connectable advertising you would use
     * bt_le_oob_get_local().  For non-connectable non-identity
     * advertising an non-resolvable private address is used;
     * there is no API to retrieve that.
     */

    bt_id_get(&addr, &count);
    bt_addr_le_to_str(&addr, addr_s, sizeof(addr_s));

    printk("Beacon started, advertising as %s\n", addr_s);
}
```

## src/sd.cpp
```c
#include "sd.h"

#include <ff.h>
#include <stdio.h>
#include <zephyr/device.h>
#include <zephyr/fs/fs.h>
#include <zephyr/kernel.h>
#include <zephyr/storage/disk_access.h>

#define DISK_DRIVE_NAME "SD"
#define DISK_MOUNT_PT "/" DISK_DRIVE_NAME ":"
#define DISK_MOUNT_PT_TEST DISK_DRIVE_NAME "/TEST"

static FATFS fat_fs;
/* mounting info */
static struct fs_mount_t mp = {
    .type = FS_FATFS,
    .fs_data = &fat_fs,
};

static const char* disk_mount_pt = DISK_MOUNT_PT;

static int get_sd_info();
static void mount_sd_card();
static int lsdir(const char* path);
static bool create_some_entries(const char* base_path);
static int sd_card_speed_test();

void init_sd_card()
{
    int res;
    static const char disk_pdrv[] = "SD";

    if (get_sd_info() == 0)
    {
        mount_sd_card();

        if (sd_card_speed_test() == 0)
        {
            printf("Speed test finished\n");
        }
        else
        {
            printf("Speed test failed\n");
        }
    }

    fs_unmount(&mp);
}

void save_entry(const accelerometer_data& data)
{
    char path[32];
    struct fs_file_t file;
    int base = strlen(disk_mount_pt);

    fs_file_t_init(&file);

    if (base >= (sizeof(path) - 10))
    {
        printf("Not enough concatenation buffer to create file paths");
        return;
    }

    strncpy(path, disk_mount_pt, sizeof(path));

    path[base++] = '/';
    path[base] = 0;
    strcat(&path[base], "data.txt");

    if (fs_open(&file, path, FS_O_CREATE | FS_O_RDWR) != 0)
    {
        printf("Failed to create file %s", path);
        return;
    }

    char buf[256];
    snprintf(buf, sizeof(buf), "x_accel: %f, y_accel: %f, z_accel: %f, x_gyro: %f, y_gyro: %f, z_gyro: %f\n",
             data.x_accel, data.y_accel, data.z_accel, data.x_gyro, data.y_gyro, data.z_gyro);

    if (fs_write(&file, buf, strlen(buf)) != strlen(buf))
    {
        fs_close(&file);
        printf("write error\n");
        return;
    }

    // The f_sync function flushes the cached information of a writing file.
    if (fs_sync(&file) != 0)
    {
        printf("sync error\n");
        return;
    }

    // The f_close function closes an open file.
    fs_close(&file);
}

int get_sd_info()
{
    /* raw disk i/o */
    static const char* disk_pdrv = DISK_DRIVE_NAME;
    uint64_t memory_size_mb;
    uint32_t block_count;
    uint32_t block_size;

    if (disk_access_init(disk_pdrv) != 0)
    {
        printf("Storage init ERROR!\n");
        return -1;
    }

    if (disk_access_ioctl(disk_pdrv, DISK_IOCTL_GET_SECTOR_COUNT, &block_count))
    {
        printf("Unable to get sector count\n");
        return -1;
    }
    printf("Block count %u\n", block_count);

    if (disk_access_ioctl(disk_pdrv, DISK_IOCTL_GET_SECTOR_SIZE, &block_size))
    {
        printf("Unable to get sector size\n");
        return -1;
    }
    printf("Sector size %u\n", block_size);

    memory_size_mb = (uint64_t)block_count * block_size;
    printf("Memory Size(MB) %u\n", (uint32_t)(memory_size_mb >> 20));

    return 0;
}

void mount_sd_card()
{
    mp.mnt_point = disk_mount_pt;

    int res = fs_mount(&mp);

    if (res == FR_OK)
    {
        printf("Disk mounted.\n");
        lsdir(disk_mount_pt);

        // if (create_some_entries(disk_mount_pt))
        // {
        //     lsdir(disk_mount_pt);
        // }
    }
    else
    {
        printf("Error mounting disk.\n");
    }
}

int lsdir(const char* path)
{
    int res;
    struct fs_dir_t dirp;
    static struct fs_dirent entry;
    int count = 0;

    fs_dir_t_init(&dirp);

    /* Verify fs_opendir() */
    res = fs_opendir(&dirp, path);
    if (res)
    {
        printf("Error opening dir %s [%d]\n", path, res);
        return res;
    }

    printf("\nListing dir %s ...\n", path);
    for (;;)
    {
        /* Verify fs_readdir() */
        res = fs_readdir(&dirp, &entry);

        /* entry.name[0] == 0 means end-of-dir */
        if (res || entry.name[0] == 0)
        {
            break;
        }

        if (entry.type == FS_DIR_ENTRY_DIR)
        {
            printf("[DIR ] %s\n", entry.name);
        }
        else
        {
            printf("[FILE] %s (size = %zu)\n", entry.name, entry.size);
        }
        count++;
    }

    /* Verify fs_closedir() */
    fs_closedir(&dirp);
    if (res == 0)
    {
        res = count;
    }

    return res;
}

#define MAX_PATH 128
#define SOME_FILE_NAME "some.dat"
#define SOME_DIR_NAME "some"
#define SOME_REQUIRED_LEN MAX(sizeof(SOME_FILE_NAME), sizeof(SOME_DIR_NAME))

bool create_some_entries(const char* base_path)
{
    char path[MAX_PATH];
    struct fs_file_t file;
    int base = strlen(base_path);

    fs_file_t_init(&file);

    if (base >= (sizeof(path) - SOME_REQUIRED_LEN))
    {
        printf("Not enough concatenation buffer to create file paths");
        return false;
    }

    printf("Creating some dir entries in %s", base_path);
    strncpy(path, base_path, sizeof(path));

    path[base++] = '/';
    path[base] = 0;
    strcat(&path[base], SOME_FILE_NAME);

    if (fs_open(&file, path, FS_O_CREATE) != 0)
    {
        printf("Failed to create file %s", path);
        return false;
    }
    fs_close(&file);

    path[base] = 0;
    strcat(&path[base], SOME_DIR_NAME);

    if (fs_mkdir(path) != 0)
    {
        printf("Failed to create dir %s", path);
        /* If code gets here, it has at least successes to create the
         * file so allow function to return true.
         */
    }
    return true;
}

#define TEST_FILE_SIZE 1024
uint8_t buf_test[TEST_FILE_SIZE];

int sd_card_speed_test()
{
    char path[MAX_PATH];
    struct fs_file_t file;
    int base = strlen(disk_mount_pt);

    fs_file_t_init(&file);

    if (base >= (sizeof(path) - SOME_REQUIRED_LEN))
    {
        printf("Not enough concatenation buffer to create file paths");
        return 0;
    }

    strncpy(path, disk_mount_pt, sizeof(path));

    path[base++] = '/';
    path[base] = 0;
    strcat(&path[base], SOME_FILE_NAME);

    if (fs_open(&file, path, FS_O_CREATE | FS_O_RDWR) != 0)
    {
        printf("Failed to create file %s", path);
        return 0;
    }

    // Create test char array with custom file size
    memset(buf_test, 'X', TEST_FILE_SIZE);

    auto start = k_uptime_get();

    for (int i = 0; i < 1024; ++i)
    {
        // // Search for End of File
        // if (fs_seek(&file, 0, FS_SEEK_END) != 0)
        // {
        //     printf("Test 1 Error: FS_SEEK failed!\n");
        //     return -1;
        // }
        if (fs_write(&file, buf_test, TEST_FILE_SIZE) != TEST_FILE_SIZE)
        {
            fs_close(&file);
            printf("write error\n");
            return -1;
        }
    }

    auto end = k_uptime_get();

    printf("Wrote %d bytes in %d ms\n", TEST_FILE_SIZE * 1024, end - start);

    // The f_sync function flushes the cached information of a writing file.
    if (fs_sync(&file) != 0)
    {
        printf("sync error\n");
        return -1;
    }

    // The f_close function closes an open file.
    fs_close(&file);

    return 0;
}
```

## src/sd.h
```c
#pragma once

#include "accelerometer.h"

void init_sd_card();

void save_entry(const accelerometer_data& data);
```

## src/sys.cpp
```c
#include <assert.h>
#include <sys/types.h>

extern "C"
{
    int _write(int handle, char* data, int size)
    {
        return -1;
    }

    int _read(int, void*, size_t)
    {
        return -1;
    }

    off_t _lseek(int, off_t, int)
    {
        return (off_t)(-1);
    }

    void __assert(const char*, int, const char*)
    {
        while (1)
        {
        }
    }

    void __assert_func(const char* file, int line, const char* func, const char* failedexpr)
    {
        while (1)
        {
        }
    }

    void _close()
    {
        assert(0);
    }

    void _exit()
    {
        assert(0);
    }

    pid_t _getpid(void)
    {
        return -1;
    }

    int _kill(int pid, int sig)
    {
        assert(0);
    }
}
```
